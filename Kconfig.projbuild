## Kconfig.projbuild
```kconfig
menu "VL53L3CX" 
    config VL53L3CX_ACTIVE
    bool "Active"
    default n
    config VL53L3CX_ADDRESS
        hex
        prompt  "VL53L3CX Time-of-Flight ranging sensor with multi target detection Address"
        default 0x29
        depends on VL53L3CX_ACTIVE
    config VL53_SHUTDOWN_PIN
        int "Shutdown Pin"
        default 17
        depends on VL53L3CX_ACTIVE
    config VL53_INTERRUPT_PIN
        int "Interrupt Pin"
        default 18 
        depends on VL53L3CX_ACTIVE
    config VL53_DISTANCE_OFFSET
        int "Distance Offset (mm)"
        default 5 
        depends on VL53L3CX_ACTIVE
    config VL53_MIN_DISTANCE
        int "Min Distance (mm)"
        default 30 
        depends on VL53L3CX_ACTIVE      
endmenu
```
